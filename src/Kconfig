## src/Kconfig
```kconfig
#
# Copyright (c) 2022 Nordic Semiconductor ASA
#
# SPDX-License-Identifier: LicenseRef-Nordic-5-Clause
#

rsource "Kconfig.defaults"

menu "Modules"

# config BUTTON_DEBOUNCE_MS
# 	int "Button debounce time in ms"
# 	default 50

#----------------------------------------------------------------------------#
menu "Log levels"

module = MAIN
module-str = main
source "subsys/logging/Kconfig.template.log_config"

module = MODULE_LED
module-str = module-led
source "subsys/logging/Kconfig.template.log_config"

endmenu # Log levels

endmenu
```
